# file: JsonTest.ioc
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Mcu.Family=STM32F3
Mcu.Name=STM32F302R(D-E)Tx
Mcu.Package=LQFP64
NVIC.PriorityGroup=NVIC_PRIORITYGROUP_4
ProjectManager.HeapSize=0x200
ProjectManager.StackSize=0x400
ProjectManager.TargetToolchain=STM32CubeIDE
RCC.AHBFreq_Value=16000000
RCC.APB1Freq_Value=16000000
RCC.APB1TimFreq_Value=16000000
RCC.APB2Freq_Value=16000000
RCC.APB2TimFreq_Value=16000000
RCC.CortexFreq_Value=16000000
RCC.HCLKFreq_Value=16000000
RCC.HSE_VALUE=8000000
RCC.HSI_VALUE=8000000
RCC.LSE_VALUE=32768
RCC.SYSCLKFreq_VALUE=16000000
RCC.SYSCLKSourceVirtual=RCC_SYSCLKSOURCE_PLLCLK
RCC.USBFreq_Value=16000000
board=custom

// file: Core/Src/main.c
/* USER CODE BEGIN Header */
/**
  ******************************************************************************
  * @file           : main.c
  * @brief          : Main program body
  ******************************************************************************
  * @attention
  *
  * Copyright (c) 2024 STMicroelectronics.
  * All rights reserved.
  *
  * This software is licensed under terms that can be found in the LICENSE file
  * in the root directory of this software component.
  * If no LICENSE file comes with this software, it is provided AS-IS.
  *
  ******************************************************************************
  */
/* USER CODE END Header */
#include "main.h"

/* USER CODE BEGIN Includes */
#include <stdio.h>
#include "JSONWriter.h"
#include "JSONParser.h"
/* USER CODE END Includes */

/* USER CODE BEGIN PV */
struct jWriteControl testJSON;
struct jsonParser testReadJSON;
struct jsonReadToken *jsonPacket;
/* USER CODE END PV */

void SystemClock_Config(void);
/* USER CODE BEGIN PFP */
void jWriteTest(void);
/* USER CODE END PFP */

int main(void)
{

  /* MCU Configuration--------------------------------------------------------*/

  /* Reset of all peripherals, Initializes the Flash interface and the Systick. */
//  HAL_Init();

  /* Configure the system clock */
//  SystemClock_Config();

  /* Initialize all configured peripherals */
  /* USER CODE BEGIN 2 */
  jWriteTest();
  /* USER CODE END 2 */

  /* Infinite loop */
  while (1)
  {

  }
}

void SystemClock_Config(void)
{
  RCC_OscInitTypeDef RCC_OscInitStruct = {0};
  RCC_ClkInitTypeDef RCC_ClkInitStruct = {0};

  /** Initializes the RCC Oscillators according to the specified parameters
  * in the RCC_OscInitTypeDef structure.
  */
  RCC_OscInitStruct.OscillatorType = RCC_OSCILLATORTYPE_HSI;
  RCC_OscInitStruct.HSIState = RCC_HSI_ON;
  RCC_OscInitStruct.HSICalibrationValue = RCC_HSICALIBRATION_DEFAULT;
  RCC_OscInitStruct.PLL.PLLState = RCC_PLL_ON;
  RCC_OscInitStruct.PLL.PLLSource = RCC_PLLSOURCE_HSI;
  RCC_OscInitStruct.PLL.PLLMUL = RCC_PLL_MUL2;
  RCC_OscInitStruct.PLL.PREDIV = RCC_PREDIV_DIV1;
  if (HAL_RCC_OscConfig(&RCC_OscInitStruct) != HAL_OK)
  {
    Error_Handler();
  }

  /** Initializes the CPU, AHB and APB buses clocks
  */
  RCC_ClkInitStruct.ClockType = RCC_CLOCKTYPE_HCLK|RCC_CLOCKTYPE_SYSCLK
                              |RCC_CLOCKTYPE_PCLK1|RCC_CLOCKTYPE_PCLK2;
  RCC_ClkInitStruct.SYSCLKSource = RCC_SYSCLKSOURCE_PLLCLK;
  RCC_ClkInitStruct.AHBCLKDivider = RCC_SYSCLK_DIV1;
  RCC_ClkInitStruct.APB1CLKDivider = RCC_HCLK_DIV1;
  RCC_ClkInitStruct.APB2CLKDivider = RCC_HCLK_DIV1;

  if (HAL_RCC_ClockConfig(&RCC_ClkInitStruct, FLASH_LATENCY_0) != HAL_OK)
  {
    Error_Handler();
  }
}

/* USER CODE BEGIN 4 */
void jWriteTest(void){
    char buffer[1024];
    unsigned int buflen = 1024;
    unsigned char err;
    //i;
//    char buffer1[1024]= "[\"array1\", 0.12345, 345, true, null, {\"key1\":\"value1\", \"int\":10}]";

//    printf("A JSON object example :\n\n");

    jwOpen(&testJSON, buffer, buflen, JW_OBJECT, JW_COMPACT);

    jwObj_string(&testJSON, "key", "value");
    jwObj_int(&testJSON, "int", 10);
    jwObj_double(&testJSON, "double", 1.265487);
    jwObj_null(&testJSON, "null Thing");
    jwObj_bool(&testJSON, "boolean", 1);
    jwObj_array(&testJSON, "EmptyArray");
    jwEnd(&testJSON);
    jwObj_array(&testJSON, "anArray");
    jwArr_string(&testJSON, "array one");
    jwArr_int(&testJSON, -1);
    jwArr_double(&testJSON, 12.568970);
    jwArr_null(&testJSON);
    jwArr_bool(&testJSON, 0);
    jwArr_object(&testJSON);
        jwObj_string(&testJSON, "objArr1", "value1");
        jwObj_string(&testJSON, "objArr2", "value2");
        jwEnd(&testJSON);
    jwArr_array(&testJSON);
        jwArr_int(&testJSON, 1);
        jwArr_int(&testJSON, 2);
        jwArr_int(&testJSON, 3);
    jwEnd(&testJSON);
    jwEnd(&testJSON);
    jwObj_object(&testJSON, "Empty Object");
    jwEnd(&testJSON);
    jwObj_object(&testJSON, "anObject");
    jwObj_string(&testJSON, "msg", "Object in Object");
    jwObj_string(&testJSON, "msg2", "Object in object 2nd");
    jwEnd(&testJSON);
    jwObj_string(&testJSON, "ObjectEntry", "This is the last one");
    jwClose(&testJSON);

//   printf(buffer);
//   printf(buffer1);

    err= JSONStructInit(&testReadJSON, buffer);
//    printf("\nThe number of tokens parsed %d \n", testReadJSON.numTokens);
//    printf("Buffer initialized for reading \n ");
//    printf("The value of error is %d \n", err);
    if(err != JDATA_NOK)
    {
        while(testReadJSON.parserStatus!=JSON_END)
        err = JSONParseData(&testReadJSON);
//        printf("The Error code is %d\n", err);
//        printf("The Number of Tokens parsed are %d\n", testReadJSON.numTokens);
//        printf("The value of key parsed is %s\n", testReadJSON.jData[2].keyValue);
//        printf("The value of data parsed is %s\n", testReadJSON.jData[5].jsonValue);
//        printf("The Value of Stack Position is %d", testReadJSON.parserStatus);
       jsonPacket = SearchToken(&testReadJSON, "\"anObject\"");
       if(jsonPacket!=NULL)
       {
//           printf("Packet Found!!!!\n");
//           printf("The Value of the entered key is %s\n", jsonPacket->jsonValue);
       }

    }

}
/* USER CODE END 4 */

void Error_Handler(void)
{
  __disable_irq();
  while (1)
  {
  }
}
